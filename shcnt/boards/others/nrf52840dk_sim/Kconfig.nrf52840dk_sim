## shcnt/boards/others/nrf52840dk_sim/Kconfig.nrf52840dk_sim
```kconfig
# Shades controller simulator board configuration

# Copyright (c) 2025 Hubert Miś
# SPDX-License-Identifier: Apache-2.0

config BOARD_NRF52840DK_SIM
	bool "nrf52840dk_sim"
	select SOC_NRF52840_QIAA
```

## shcnt/boards/others/shcnt/Kconfig.shcnt
```kconfig
# Shades controller board configuration

# Copyright (c) 2021 Hubert Miś
# SPDX-License-Identifier: Apache-2.0

config BOARD_SHCNT
	bool "shcnt"
	select SOC_NRF52840_QIAA
```

## shcnt/boards/others/shcnt/board.yml
```yaml
board:
  name: shcnt
  full_name: shcnt
  vendor: others
  socs:
    - name: nrf52840
```

## switch/boards/others/switch/Kconfig.switch
```kconfig
# Switch board configuration

# Copyright (c) 2022 Hubert Miś
# SPDX-License-Identifier: Apache-2.0

config BOARD_SWITCH
	bool "switch"
	select SOC_NRF52840_QIAA
```

## switch/boards/others/switch/board.yml
```yaml
board:
  name: switch
  full_name: switch
  vendor: others
  socs:
    - name: nrf52840
```

## temp_tscrn/boards/others/temp_tscrn/board.yml
```yaml
board:
  name: temp_tscrn
  full_name: temp_tscrn
  vendor: others
  socs:
    - name: nrf52840
```

## west.yml
```yaml
manifest:
  version: "1.0"
  remotes:
    - name: hubertmis
      url-base: https://github.com/hubertmis
    - name: nrfconnect
      url-base: https://github.com/nrfconnect
  projects:
    - name: zephyr
      remote: hubertmis
      repo-path: sdk-nrf
      revision: 311946426657ba63535456ca67d8a00fa514eae7
      import:
        # This list is copied from sdk-nrf/west.yml
        name-allowlist:
          - canopennode
          - chre
          - cmsis
          - cmsis-dsp
          - cmsis-nn
          - cmsis_6
          - dhara
          - edtt
          - fatfs
          - hal_nordic
          - hal_st # required for ST sensors (unrelated to STM32 MCUs)
          - hal_tdk # required for Invensense sensors such as ICM42670
          - hal_wurthelektronik
          - liblc3
          - libmetal
          - libsbc
          - littlefs
          - loramac-node
          - lvgl
          - lz4
          - mipi-sys-t
          - nanopb
          - net-tools
          - nrf_hw_models
          - nrf_wifi
          - open-amp
          - percepio
          - picolibc
          - segger
          - tf-m-tests
          - uoscore-uedhoc
          - zcbor
          - zscilib
    - name: ncs
      description: nRF Connect SDK
      remote: nrfconnect
      repo-path: sdk-nrf
      path: nrf
      revision: v3.3.0
      clone-depth: 1
      import: true
```

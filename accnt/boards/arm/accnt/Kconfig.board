## accnt/boards/arm/accnt/Kconfig.board
```kconfig
# Accnt board configuration

# Copyright (c) 2022 Hubert Miś
# SPDX-License-Identifier: Apache-2.0

config BOARD_ACCNT
	bool "accnt"
	depends on SOC_NRF52840_QIAA
```

## accnt/boards/arm/accnt/Kconfig.defconfig
```kconfig
# Accnt project board configuration

# Copyright (c) 2022 Hubert Miś
# SPDX-License-Identifier: Apache-2.0

if BOARD_ACCNT

config BOARD
	default "accnt"

endif # BOARD_ACCNT
```

## accnt/boards/arm/switch/Kconfig.defconfig
```kconfig
# Switch project board configuration

# Copyright (c) 2022 Hubert Miś
# SPDX-License-Identifier: Apache-2.0

if BOARD_SWITCH

config BOARD
	default "switch"

endif # BOARD_SWITCH
```

## prjcnt/boards/arm/prjcnt/Kconfig.board
```kconfig
# Prjcnt board configuration

# Copyright (c) 2022 Hubert Miś
# SPDX-License-Identifier: Apache-2.0

config BOARD_PRJCNT
	bool "prjcnt"
	depends on SOC_NRF52840_QIAA
```

## prjcnt/boards/arm/prjcnt/Kconfig.defconfig
```kconfig
# Prjcnt project board configuration

# Copyright (c) 2022 Hubert Miś
# SPDX-License-Identifier: Apache-2.0

if BOARD_PRJCNT

config BOARD
	default "prjcnt"

endif # BOARD_PRJCNT
```

## prjcnt/boards/others/prjcnt/Kconfig.prjcnt
```kconfig
# prjcnt board configuration

# Copyright (c) 2024 Hubert Miś
# SPDX-License-Identifier: Apache-2.0

config BOARD_PRJCNT
	bool "prjcnt"
	select SOC_NRF52840_QIAA
```

## rgbw/boards/arm/rgbw/Kconfig.board
```kconfig
# Temp tscrn board configuration

# Copyright (c) 2021 Hubert Miś
# SPDX-License-Identifier: Apache-2.0

config BOARD_RGBW
	bool "rgbw"
	depends on SOC_NRF52840_QIAA
```

## rgbw/boards/arm/rgbw/Kconfig.defconfig
```kconfig
# RGBW project board configuration

# Copyright (c) 2021 Hubert Miś
# SPDX-License-Identifier: Apache-2.0

if BOARD_RGBW

config BOARD
	default "rgbw"

endif # BOARD_RGBW
```

## shcnt/boards/arm/nrf52840dk_sim/Kconfig.board
```kconfig
# Shades controller simulator board configuration

# Copyright (c) 2021 Hubert Miś
# SPDX-License-Identifier: Apache-2.0

config BOARD_SHCNT_SIM
	bool "shcnt_sim"
	depends on SOC_NRF52840_QIAA
```

## shcnt/boards/arm/nrf52840dk_sim/Kconfig.defconfig
```kconfig
# Shades controller simulator project board configuration

# Copyright (c) 2021 Hubert Miś
# SPDX-License-Identifier: Apache-2.0

if BOARD_SHCNT_SIM

config BOARD
	default "shcnt_sim"

endif # BOARD_SHCNT_SIM
```

## shcnt/boards/arm/shcnt/Kconfig.board
```kconfig
# Shades controller board configuration

# Copyright (c) 2021 Hubert Miś
# SPDX-License-Identifier: Apache-2.0

config BOARD_SHCNT
	bool "shcnt"
	depends on SOC_NRF52840_QIAA
```

## shcnt/boards/arm/shcnt/Kconfig.defconfig
```kconfig
# Shades controller project board configuration

# Copyright (c) 2021 Hubert Miś
# SPDX-License-Identifier: Apache-2.0

if BOARD_SHCNT

config BOARD
	default "shcnt"

endif # BOARD_SHCNT
```

## switch/boards/others/bat_switch/Kconfig.board
```kconfig
# Battery powered Switch board configuration

# Copyright (c) 2022 Hubert Miś
# SPDX-License-Identifier: Apache-2.0

config BOARD_BAT_SWITCH
	bool "bat_switch"
	depends on SOC_NRF52840_QIAA
```

## switch/boards/others/bat_switch/Kconfig.defconfig
```kconfig
# Battery powered switch project board configuration

# Copyright (c) 2022 Hubert Miś
# SPDX-License-Identifier: Apache-2.0

if BOARD_BAT_SWITCH

config BOARD
	default "bat_switch"

endif # BOARD_BAT_SWITCH
```

## temp_tscrn/boards/arm/temp_tscrn/Kconfig.defconfig
```kconfig
# Temp tscrn project board configuration

# Copyright (c) 2020 Hubert Miś
# SPDX-License-Identifier: Apache-2.0

if BOARD_TEMP_TSCRN

config BOARD
	default "temp_tscrn"

endif # BOARD_TEMP_TSCRN
```
